// Generated by tools/generate_weather_icons.ps1; do not edit bitmap bytes manually.
// QWeather Icons revision: d7d4ef4d8334f9e70a75a088cb77804bf81daea4
// Copyright QWeather; CC BY 4.0. See assets/qweather/NOTICE.txt.
const Condition CONDITIONS[] = {
    {100, "晴", "晴", Color4::Yellow},
    {101, "多云", "多云", Color4::Black},
    {102, "少云", "少云", Color4::Black},
    {103, "晴间多云", "晴间多云", Color4::Black},
    {104, "阴", "阴", Color4::Black},
    {150, "晴（夜间）", "夜晴", Color4::Yellow},
    {151, "多云（夜间）", "夜间多云", Color4::Black},
    {152, "少云（夜间）", "夜间少云", Color4::Black},
    {153, "晴间多云（夜间）", "夜间多云", Color4::Black},
    {300, "阵雨", "阵雨", Color4::Black},
    {301, "强阵雨", "强阵雨", Color4::Black},
    {302, "雷阵雨", "雷阵雨", Color4::Red},
    {303, "强雷阵雨", "强雷阵雨", Color4::Red},
    {304, "雷阵雨伴有冰雹", "雷雨冰雹", Color4::Red},
    {305, "小雨", "小雨", Color4::Black},
    {306, "中雨", "中雨", Color4::Black},
    {307, "大雨", "大雨", Color4::Black},
    {308, "极端降雨", "极端降雨", Color4::Black},
    {309, "毛毛雨/细雨", "细雨", Color4::Black},
    {310, "暴雨", "暴雨", Color4::Black},
    {311, "大暴雨", "大暴雨", Color4::Black},
    {312, "特大暴雨", "特大暴雨", Color4::Black},
    {313, "冻雨", "冻雨", Color4::Black},
    {314, "小到中雨", "小到中雨", Color4::Black},
    {315, "中到大雨", "中到大雨", Color4::Black},
    {316, "大到暴雨", "大到暴雨", Color4::Black},
    {317, "暴雨到大暴雨", "暴雨转强", Color4::Black},
    {318, "大暴雨到特大暴雨", "暴雨转极", Color4::Black},
    {350, "阵雨（夜间）", "夜间阵雨", Color4::Black},
    {351, "强阵雨（夜间）", "夜强阵雨", Color4::Black},
    {399, "雨", "雨", Color4::Black},
    {400, "小雪", "小雪", Color4::Black},
    {401, "中雪", "中雪", Color4::Black},
    {402, "大雪", "大雪", Color4::Black},
    {403, "暴雪", "暴雪", Color4::Black},
    {404, "雨夹雪", "雨夹雪", Color4::Black},
    {405, "雨雪天气", "雨雪", Color4::Black},
    {406, "阵雨夹雪", "阵雨夹雪", Color4::Black},
    {407, "阵雪", "阵雪", Color4::Black},
    {408, "小到中雪", "小到中雪", Color4::Black},
    {409, "中到大雪", "中到大雪", Color4::Black},
    {410, "大到暴雪", "大到暴雪", Color4::Black},
    {456, "阵雨夹雪（夜间）", "夜雨夹雪", Color4::Black},
    {457, "阵雪（夜间）", "夜间阵雪", Color4::Black},
    {499, "雪", "雪", Color4::Black},
    {500, "薄雾", "薄雾", Color4::Black},
    {501, "雾", "雾", Color4::Black},
    {502, "霾", "霾", Color4::Black},
    {503, "扬沙", "扬沙", Color4::Black},
    {504, "浮尘", "浮尘", Color4::Black},
    {507, "沙尘暴", "沙尘暴", Color4::Black},
    {508, "强沙尘暴", "强沙尘暴", Color4::Black},
    {509, "浓雾", "浓雾", Color4::Black},
    {510, "强浓雾", "强浓雾", Color4::Black},
    {511, "中度霾", "中度霾", Color4::Black},
    {512, "重度霾", "重度霾", Color4::Black},
    {513, "严重霾", "严重霾", Color4::Black},
    {514, "大雾", "大雾", Color4::Black},
    {515, "特强浓雾", "特强浓雾", Color4::Black},
    {900, "热", "热", Color4::Red},
    {901, "冷", "冷", Color4::Black},
    {999, "未知", "未知", Color4::Black},
};
const uint8_t ICON_BITMAPS[][ICON_BYTES] PROGMEM = {
    { // 100
        0x00, 0x00, 0x00, 0x00, 0x00, 0x01, 0x00, 0x00, 0x00, 0x03, 0x00, 0x00,
        0x00, 0x03, 0x00, 0x00, 0x00, 0x03, 0x00, 0x00, 0x06, 0x01, 0x00, 0x80,
        0x07, 0x00, 0x01, 0xC0, 0x03, 0x83, 0x83, 0x80, 0x01, 0x9F, 0xF3, 0x00,
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        0x00, 0x03, 0x00, 0x00, 0x00, 0x03, 0x00, 0x00, 0x00, 0x00, 0x00, 0x00,
    },
    { // 101
        0x00, 0x00, 0x00, 0x00, 0x00, 0x20, 0x00, 0x00, 0x00, 0x70, 0x00, 0x00,
        0x00, 0x30, 0x60, 0x00, 0x00, 0x30, 0xE0, 0x00, 0x00, 0x00, 0xC0, 0x00,
        0x18, 0x3E, 0x00, 0x00, 0x1C, 0xFF, 0x80, 0x00, 0x05, 0xE3, 0xC0, 0x00,
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        0x00, 0x3E, 0x78, 0x00, 0x00, 0x0F, 0xF0, 0x00, 0x00, 0x00, 0x00, 0x00,
    },
    { // 102
        0x00, 0x00, 0x00, 0x00, 0x00, 0x01, 0x00, 0x00, 0x00, 0x03, 0x00, 0x00,
        0x00, 0x03, 0x00, 0x00, 0x00, 0x03, 0x00, 0x00, 0x06, 0x01, 0x00, 0x80,
        0x07, 0x00, 0x01, 0xC0, 0x03, 0x83, 0x83, 0x80, 0x01, 0x9F, 0xF3, 0x00,
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        0x00, 0x07, 0xE3, 0xF0, 0x00, 0x00, 0x3F, 0x00, 0x00, 0x00, 0x00, 0x00,
    },
    { // 103
        0x00, 0x00, 0x00, 0x00, 0x00, 0x01, 0x00, 0x00, 0x00, 0x03, 0x00, 0x00,
        0x00, 0x03, 0x00, 0x00, 0x00, 0x03, 0x00, 0x00, 0x06, 0x01, 0x00, 0x80,
        0x07, 0x00, 0x01, 0xC0, 0x03, 0x83, 0x83, 0x80, 0x01, 0x8F, 0xF3, 0x00,
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        0x03, 0xFF, 0xCF, 0xF0, 0x00, 0x3F, 0xFE, 0xE0, 0x00, 0x00, 0x00, 0x00,
    },
    { // 104
        0x00, 0x00, 0x00, 0x00, 0x00, 0x00, 0x00, 0x00, 0x00, 0x00, 0x00, 0x00,
        0x00, 0x01, 0xE0, 0x00, 0x00, 0x07, 0xF8, 0x00, 0x00, 0x0F, 0x3C, 0x00,
        0x00, 0x7C, 0x0F, 0x80, 0x00, 0xF8, 0x07, 0xC0, 0x01, 0xC0, 0x00, 0xE0,
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        0x00, 0x00, 0x00, 0x00, 0x00, 0x00, 0x00, 0x00, 0x00, 0x00, 0x00, 0x00,
    },
    { // 150
        0x00, 0x00, 0x00, 0x00, 0x00, 0x60, 0x00, 0x00, 0x00, 0xE0, 0x00, 0x00,
        0x03, 0xE0, 0x00, 0x00, 0x07, 0x60, 0x00, 0x00, 0x0E, 0x60, 0x00, 0x00,
        0x0C, 0x60, 0x00, 0x00, 0x18, 0x60, 0x00, 0x00, 0x18, 0x60, 0x00, 0x00,
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        0x00, 0x7F, 0xFF, 0x00, 0x00, 0x1F, 0xFC, 0x00, 0x00, 0x00, 0x00, 0x00,
    },
    { // 151
        0x00, 0x00, 0x00, 0x00, 0x00, 0x00, 0x00, 0x00, 0x00, 0x00, 0x20, 0x00,
        0x00, 0x00, 0xE0, 0x00, 0x00, 0x01, 0xE0, 0x00, 0x00, 0x03, 0xE0, 0x00,
        0x00, 0x03, 0x60, 0x00, 0x00, 0x07, 0x30, 0x00, 0x00, 0x06, 0x30, 0x00,
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        0x00, 0x3F, 0xC0, 0x00, 0x00, 0x00, 0x00, 0x00, 0x00, 0x00, 0x00, 0x00,
    },
    { // 152
        0x00, 0x00, 0x00, 0x00, 0x00, 0x02, 0x00, 0x00, 0x00, 0x07, 0x00, 0x00,
        0x00, 0x0F, 0x00, 0x00, 0x00, 0x1E, 0x00, 0x00, 0x00, 0x36, 0x00, 0x00,
        0x00, 0x76, 0x00, 0x00, 0x00, 0x66, 0x00, 0x00, 0x00, 0x67, 0x00, 0x00,
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        0x1F, 0x0F, 0xC0, 0x00, 0x01, 0xF8, 0x00, 0x00, 0x00, 0x00, 0x00, 0x00,
    },
    { // 153
        0x00, 0x00, 0x00, 0x00, 0x00, 0x03, 0x00, 0x00, 0x00, 0x07, 0x00, 0x00,
        0x00, 0x1F, 0x00, 0x00, 0x00, 0x3F, 0x00, 0x00, 0x00, 0x33, 0x00, 0x00,
        0x00, 0x73, 0x00, 0x00, 0x00, 0x63, 0x00, 0x00, 0x00, 0xE3, 0x80, 0x00,
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        0x0B, 0xFF, 0xEE, 0x00, 0x00, 0x00, 0x00, 0x00, 0x00, 0x00, 0x00, 0x00,
    },
    { // 300
        0x00, 0x00, 0x00, 0x00, 0x00, 0x00, 0x00, 0x00, 0x00, 0x60, 0x00, 0x00,
        0x00, 0x60, 0x00, 0x00, 0x00, 0x60, 0x00, 0x00, 0x1C, 0x23, 0x80, 0x00,
        0x0E, 0x23, 0x00, 0x00, 0x05, 0xF8, 0x00, 0x00, 0x03, 0xC1, 0xC0, 0x00,
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        0x00, 0x78, 0x0E, 0x00, 0x00, 0x00, 0x00, 0x00, 0x00, 0x00, 0x00, 0x00,
    },
    { // 301
        0x00, 0x00, 0x00, 0x00, 0x00, 0x60, 0x00, 0x00, 0x00, 0x60, 0x00, 0x00,
        0x00, 0x60, 0x00, 0x00, 0x1C, 0x63, 0x80, 0x00, 0x0E, 0x03, 0x00, 0x00,
        0x05, 0xF8, 0x00, 0x00, 0x03, 0xE1, 0xC0, 0x00, 0x03, 0x0F, 0xF0, 0x00,
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        0x00, 0x63, 0xC6, 0x00, 0x00, 0x01, 0xC0, 0x00, 0x00, 0x00, 0x00, 0x00,
    },
    { // 302
        0x00, 0x00, 0x00, 0x00, 0x00, 0x07, 0x80, 0x00, 0x00, 0x1F, 0xF0, 0x00,
        0x00, 0x78, 0x78, 0x00, 0x00, 0xE0, 0x1C, 0x00, 0x01, 0xC0, 0x0E, 0x00,
        0x0F, 0x80, 0x07, 0xE0, 0x1F, 0x80, 0x03, 0xF0, 0x30, 0x00, 0x00, 0x38,
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        0x00, 0x03, 0x00, 0x00, 0x00, 0x06, 0x00, 0x00, 0x00, 0x00, 0x00, 0x00,
    },
    { // 303
        0x00, 0x00, 0x00, 0x00, 0x00, 0x07, 0x80, 0x00, 0x00, 0x1F, 0xF0, 0x00,
        0x00, 0x78, 0x78, 0x00, 0x00, 0xE0, 0x1C, 0x00, 0x01, 0xC0, 0x0E, 0x00,
        0x0F, 0x80, 0x07, 0xE0, 0x1F, 0x80, 0x03, 0xF0, 0x30, 0x00, 0x00, 0x38,
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        0x00, 0x03, 0x00, 0x00, 0x00, 0x06, 0x00, 0x00, 0x00, 0x00, 0x00, 0x00,
    },
    { // 304
        0x00, 0x00, 0x00, 0x00, 0x00, 0x07, 0x80, 0x00, 0x00, 0x1F, 0xF0, 0x00,
        0x00, 0x78, 0x78, 0x00, 0x00, 0xE0, 0x1C, 0x00, 0x01, 0xC0, 0x0E, 0x00,
        0x0F, 0x80, 0x07, 0xE0, 0x1F, 0x80, 0x03, 0xF0, 0x30, 0x00, 0x00, 0x38,
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        0x00, 0x03, 0x00, 0x00, 0x00, 0x06, 0x00, 0x00, 0x00, 0x00, 0x00, 0x00,
    },
    { // 305
        0x00, 0x00, 0x00, 0x00, 0x00, 0x00, 0x00, 0x00, 0x00, 0x07, 0x80, 0x00,
        0x00, 0x1F, 0xF0, 0x00, 0x00, 0x78, 0x78, 0x00, 0x00, 0xE0, 0x1C, 0x00,
        0x01, 0xC0, 0x0E, 0x00, 0x0F, 0x80, 0x07, 0xE0, 0x3F, 0x80, 0x03, 0xF0,
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        0x00, 0xF0, 0x1C, 0x00, 0x00, 0x00, 0x00, 0x00, 0x00, 0x00, 0x00, 0x00,
    },
    { // 306
        0x00, 0x00, 0x00, 0x00, 0x00, 0x07, 0x80, 0x00, 0x00, 0x1F, 0xF0, 0x00,
        0x00, 0x78, 0x78, 0x00, 0x00, 0xE0, 0x1C, 0x00, 0x01, 0xC0, 0x0E, 0x00,
        0x0F, 0x80, 0x07, 0xE0, 0x1F, 0x80, 0x03, 0xF0, 0x30, 0x00, 0x00, 0x38,
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        0x00, 0x07, 0x80, 0x00, 0x00, 0x03, 0x80, 0x00, 0x00, 0x00, 0x00, 0x00,
    },
    { // 307
        0x00, 0x00, 0x00, 0x00, 0x00, 0x07, 0x80, 0x00, 0x00, 0x1F, 0xF0, 0x00,
        0x00, 0x78, 0x78, 0x00, 0x00, 0xE0, 0x1C, 0x00, 0x01, 0xC0, 0x0E, 0x00,
        0x0F, 0x80, 0x07, 0xE0, 0x1F, 0x80, 0x03, 0xF0, 0x30, 0x00, 0x00, 0x38,
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        0x00, 0x3C, 0x78, 0x00, 0x00, 0x38, 0x70, 0x00, 0x00, 0x00, 0x00, 0x00,
    },
    { // 308
        0x00, 0x00, 0x00, 0x00, 0x00, 0x07, 0x80, 0x00, 0x00, 0x1F, 0xF0, 0x00,
        0x00, 0x78, 0x78, 0x00, 0x00, 0xE0, 0x1C, 0x00, 0x01, 0xC0, 0x0E, 0x00,
        0x0F, 0x80, 0x07, 0xE0, 0x1F, 0x80, 0x03, 0xF0, 0x30, 0x00, 0x00, 0x38,
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        0x00, 0x37, 0x90, 0x00, 0x00, 0x03, 0x80, 0x00, 0x00, 0x00, 0x00, 0x00,
    },
    { // 309
        0x00, 0x00, 0x00, 0x00, 0x00, 0x07, 0x80, 0x00, 0x00, 0x1F, 0xF0, 0x00,
        0x00, 0x78, 0x78, 0x00, 0x00, 0xE0, 0x1C, 0x00, 0x01, 0xC0, 0x0E, 0x00,
        0x0F, 0x80, 0x07, 0xE0, 0x1F, 0x80, 0x03, 0xF0, 0x30, 0x00, 0x00, 0x38,
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        0x00, 0x06, 0x00, 0x00, 0x00, 0x00, 0x00, 0x00, 0x00, 0x00, 0x00, 0x00,
    },
    { // 310
        0x00, 0x00, 0x00, 0x00, 0x00, 0x07, 0x80, 0x00, 0x00, 0x1F, 0xF0, 0x00,
        0x00, 0x78, 0x78, 0x00, 0x00, 0xE0, 0x1C, 0x00, 0x01, 0xC0, 0x0E, 0x00,
        0x0F, 0x80, 0x07, 0xE0, 0x1F, 0x80, 0x03, 0xF0, 0x30, 0x00, 0x00, 0x38,
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        0x00, 0x07, 0x80, 0x00, 0x00, 0x03, 0x80, 0x00, 0x00, 0x00, 0x00, 0x00,
    },
    { // 311
        0x00, 0x00, 0x00, 0x00, 0x00, 0x07, 0x80, 0x00, 0x00, 0x1F, 0xF0, 0x00,
        0x00, 0x78, 0x78, 0x00, 0x00, 0xE0, 0x1C, 0x00, 0x01, 0xC0, 0x0E, 0x00,
        0x0F, 0x80, 0x07, 0xE0, 0x1F, 0x80, 0x03, 0xF0, 0x30, 0x00, 0x00, 0x38,
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        0x00, 0x0C, 0x00, 0x00, 0x00, 0x0C, 0x00, 0x00, 0x00, 0x00, 0x00, 0x00,
    },
    { // 312
        0x00, 0x00, 0x00, 0x00, 0x00, 0x00, 0x00, 0x00, 0x00, 0x07, 0x80, 0x00,
        0x00, 0x1F, 0xF0, 0x00, 0x00, 0x78, 0x78, 0x00, 0x00, 0xE0, 0x1C, 0x00,
        0x01, 0xC0, 0x0E, 0x00, 0x0F, 0x80, 0x07, 0xE0, 0x3F, 0x80, 0x03, 0xF0,
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        0x63, 0x18, 0xC6, 0x30, 0x00, 0x00, 0x00, 0x00, 0x00, 0x00, 0x00, 0x00,
    },
    { // 313
        0x00, 0x00, 0x00, 0x00, 0x00, 0x07, 0x80, 0x00, 0x00, 0x1F, 0xF0, 0x00,
        0x00, 0x7C, 0x78, 0x00, 0x00, 0xE0, 0x1C, 0x00, 0x01, 0xC0, 0x0E, 0x00,
        0x0F, 0x80, 0x07, 0xE0, 0x1F, 0x80, 0x03, 0xF0, 0x30, 0x00, 0x00, 0x38,
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        0x00, 0x03, 0x80, 0x00, 0x00, 0x03, 0x00, 0x00, 0x00, 0x00, 0x00, 0x00,
    },
    { // 314
        0x00, 0x00, 0x00, 0x00, 0x00, 0x01, 0x00, 0x00, 0x00, 0x03, 0x80, 0x00,
        0x00, 0x3F, 0xF8, 0x00, 0x00, 0xFF, 0xFE, 0x00, 0x03, 0xCE, 0xEF, 0x80,
        0x07, 0x1C, 0x61, 0xC0, 0x0E, 0x18, 0x30, 0xE0, 0x18, 0x18, 0x30, 0x70,
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        0x00, 0x03, 0x02, 0x00, 0x00, 0x03, 0x00, 0x00, 0x00, 0x00, 0x00, 0x00,
    },
    { // 315
        0x00, 0x00, 0x00, 0x00, 0x00, 0x01, 0x00, 0x00, 0x00, 0x03, 0x80, 0x00,
        0x00, 0x3F, 0xF8, 0x00, 0x00, 0xFF, 0xFE, 0x00, 0x03, 0xCE, 0xEF, 0x80,
        0x07, 0x1C, 0x61, 0xC0, 0x0E, 0x18, 0x30, 0xE0, 0x18, 0x18, 0x30, 0x70,
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        0x00, 0x83, 0x1C, 0xF0, 0x00, 0x03, 0x08, 0x40, 0x00, 0x00, 0x00, 0x00,
    },
    { // 316
        0x00, 0x00, 0x00, 0x00, 0x00, 0x01, 0x00, 0x00, 0x00, 0x03, 0x80, 0x00,
        0x00, 0x3F, 0xF8, 0x00, 0x00, 0xFF, 0xFE, 0x00, 0x03, 0xCE, 0xEF, 0x80,
        0x07, 0x1C, 0x61, 0xC0, 0x0E, 0x18, 0x30, 0xE0, 0x18, 0x18, 0x30, 0x70,
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        0x0C, 0x63, 0x08, 0x60, 0x00, 0x03, 0x00, 0x00, 0x00, 0x00, 0x00, 0x00,
    },
    { // 317
        0x00, 0x00, 0x00, 0x00, 0x00, 0x01, 0x00, 0x00, 0x00, 0x03, 0x80, 0x00,
        0x00, 0x3F, 0xF8, 0x00, 0x00, 0xFF, 0xFE, 0x00, 0x03, 0xCE, 0xEF, 0x80,
        0x07, 0x1C, 0x61, 0xC0, 0x0E, 0x18, 0x30, 0xE0, 0x18, 0x18, 0x30, 0x70,
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        0x04, 0x33, 0x04, 0xC0, 0x00, 0x03, 0x00, 0x00, 0x00, 0x00, 0x00, 0x00,
    },
    { // 318
        0x00, 0x00, 0x00, 0x00, 0x00, 0x01, 0x00, 0x00, 0x00, 0x03, 0x80, 0x00,
        0x00, 0x3F, 0xF8, 0x00, 0x00, 0xFF, 0xFE, 0x00, 0x03, 0xCE, 0xEF, 0x80,
        0x07, 0x1C, 0x61, 0xC0, 0x0E, 0x18, 0x30, 0xE0, 0x18, 0x18, 0x30, 0x70,
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        0x04, 0x43, 0x11, 0x20, 0x00, 0x03, 0x00, 0x00, 0x00, 0x00, 0x00, 0x00,
    },
    { // 350
        0x00, 0x00, 0x00, 0x00, 0x00, 0x00, 0x0C, 0x00, 0x00, 0x00, 0x1C, 0x00,
        0x00, 0x00, 0x3C, 0x00, 0x00, 0x00, 0x3C, 0x00, 0x00, 0x00, 0x6C, 0x00,
        0x00, 0x00, 0x6E, 0x00, 0x00, 0x07, 0x07, 0x00, 0x00, 0x3F, 0xE3, 0x80,
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        0x01, 0xE0, 0x3C, 0x00, 0x00, 0xE0, 0x3C, 0x00, 0x00, 0x00, 0x00, 0x00,
    },
    { // 351
        0x00, 0x00, 0x00, 0x00, 0x00, 0x00, 0x0C, 0x00, 0x00, 0x00, 0x1C, 0x00,
        0x00, 0x00, 0x3C, 0x00, 0x00, 0x00, 0x3C, 0x00, 0x00, 0x00, 0x6C, 0x00,
        0x00, 0x00, 0x6E, 0x00, 0x00, 0x07, 0x07, 0x00, 0x00, 0x3F, 0xE3, 0x80,
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        0x00, 0x87, 0x0C, 0x00, 0x00, 0x07, 0x00, 0x00, 0x00, 0x00, 0x00, 0x00,
    },
    { // 399
        0x00, 0x00, 0x00, 0x00, 0x00, 0x00, 0x00, 0x00, 0x00, 0x00, 0x01, 0x80,
        0x00, 0x20, 0x03, 0xC0, 0x00, 0x60, 0x03, 0x60, 0x00, 0xF0, 0x06, 0x60,
        0x00, 0xF8, 0x0C, 0x30, 0x01, 0x98, 0x0C, 0x10, 0x03, 0x8C, 0x18, 0x18,
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        0x0F, 0xFF, 0x00, 0x00, 0x03, 0xFC, 0x00, 0x00, 0x00, 0x00, 0x00, 0x00,
    },
    { // 400
        0x00, 0x00, 0x00, 0x00, 0x00, 0x00, 0x00, 0x00, 0x00, 0x07, 0x80, 0x00,
        0x00, 0x1F, 0xF0, 0x00, 0x00, 0x78, 0x78, 0x00, 0x00, 0xE0, 0x1C, 0x00,
        0x01, 0xC0, 0x0E, 0x00, 0x0F, 0x80, 0x07, 0xE0, 0x3F, 0x80, 0x03, 0xF0,
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        0x00, 0x30, 0x18, 0x00, 0x00, 0x00, 0x00, 0x00, 0x00, 0x00, 0x00, 0x00,
    },
    { // 401
        0x00, 0x00, 0x00, 0x00, 0x00, 0x07, 0x80, 0x00, 0x00, 0x1F, 0xF0, 0x00,
        0x00, 0x78, 0x78, 0x00, 0x00, 0xE0, 0x1C, 0x00, 0x01, 0xC0, 0x0E, 0x00,
        0x0F, 0x80, 0x07, 0xE0, 0x1F, 0x80, 0x03, 0xF0, 0x30, 0x00, 0x00, 0x38,
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        0x00, 0x07, 0xC0, 0x00, 0x00, 0x03, 0x00, 0x00, 0x00, 0x00, 0x00, 0x00,
    },
    { // 402
        0x00, 0x00, 0x00, 0x00, 0x00, 0x00, 0x00, 0x00, 0x00, 0x07, 0x80, 0x00,
        0x00, 0x1F, 0xF0, 0x00, 0x00, 0x78, 0x78, 0x00, 0x00, 0xE0, 0x1C, 0x00,
        0x01, 0xC0, 0x0E, 0x00, 0x0F, 0x80, 0x07, 0xE0, 0x3F, 0x80, 0x03, 0xF0,
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        0x00, 0x30, 0x18, 0x00, 0x00, 0x00, 0x00, 0x00, 0x00, 0x00, 0x00, 0x00,
    },
    { // 403
        0x00, 0x00, 0x00, 0x00, 0x00, 0x07, 0x80, 0x00, 0x00, 0x1F, 0xF0, 0x00,
        0x00, 0x78, 0x78, 0x00, 0x00, 0xE0, 0x1C, 0x00, 0x01, 0xC0, 0x0E, 0x00,
        0x0F, 0x80, 0x07, 0xE0, 0x1F, 0x80, 0x03, 0xF0, 0x30, 0x00, 0x00, 0x38,
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        0x00, 0x47, 0xC4, 0x00, 0x00, 0x03, 0x00, 0x00, 0x00, 0x00, 0x00, 0x00,
    },
    { // 404
        0x00, 0x00, 0x00, 0x00, 0x00, 0x07, 0x80, 0x00, 0x00, 0x1F, 0xF0, 0x00,
        0x00, 0x78, 0x78, 0x00, 0x00, 0xE0, 0x1C, 0x00, 0x01, 0xC0, 0x0E, 0x00,
        0x0F, 0x80, 0x07, 0xE0, 0x1F, 0x80, 0x03, 0xF0, 0x30, 0x00, 0x00, 0x38,
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        0x00, 0x78, 0x7C, 0x00, 0x00, 0x30, 0x18, 0x00, 0x00, 0x00, 0x00, 0x00,
    },
    { // 405
        0x00, 0x00, 0x00, 0x00, 0x00, 0x00, 0x00, 0x00, 0x00, 0x07, 0x80, 0x00,
        0x00, 0x1F, 0xF0, 0x00, 0x00, 0x78, 0x78, 0x00, 0x00, 0xE0, 0x1C, 0x00,
        0x01, 0xC0, 0x0E, 0x00, 0x0F, 0x80, 0x07, 0xE0, 0x3F, 0x80, 0x03, 0xF0,
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        0x78, 0xF0, 0x60, 0x30, 0x00, 0x00, 0x00, 0x00, 0x00, 0x00, 0x00, 0x00,
    },
    { // 406
        0x00, 0x00, 0x00, 0x00, 0x00, 0x20, 0x00, 0x00, 0x00, 0x60, 0x00, 0x00,
        0x00, 0x60, 0x00, 0x00, 0x0C, 0x23, 0x80, 0x00, 0x0E, 0x03, 0x00, 0x00,
        0x05, 0xF8, 0x00, 0x00, 0x03, 0xC1, 0xC0, 0x00, 0x03, 0x0F, 0xF0, 0x00,
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        0x00, 0x78, 0x3E, 0x00, 0x00, 0x78, 0x08, 0x00, 0x00, 0x00, 0x00, 0x00,
    },
    { // 407
        0x00, 0x00, 0x00, 0x00, 0x00, 0x20, 0x00, 0x00, 0x00, 0x60, 0x00, 0x00,
        0x00, 0x60, 0x00, 0x00, 0x0C, 0x23, 0x80, 0x00, 0x0E, 0x03, 0x00, 0x00,
        0x05, 0xF8, 0x00, 0x00, 0x03, 0xC1, 0xC0, 0x00, 0x03, 0x0F, 0xF0, 0x00,
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        0x00, 0x7C, 0x3E, 0x00, 0x00, 0x18, 0x08, 0x00, 0x00, 0x00, 0x00, 0x00,
    },
    { // 408
        0x00, 0x00, 0x00, 0x00, 0x00, 0x01, 0x00, 0x00, 0x00, 0x03, 0x80, 0x00,
        0x00, 0x3F, 0xF8, 0x00, 0x00, 0xFF, 0xFE, 0x00, 0x03, 0xCE, 0xEF, 0x80,
        0x07, 0x1C, 0x61, 0xC0, 0x0E, 0x18, 0x30, 0xE0, 0x18, 0x18, 0x30, 0x70,
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        0x00, 0x03, 0x01, 0x00, 0x00, 0x03, 0x00, 0x00, 0x00, 0x00, 0x00, 0x00,
    },
    { // 409
        0x00, 0x00, 0x00, 0x00, 0x00, 0x01, 0x00, 0x00, 0x00, 0x03, 0x80, 0x00,
        0x00, 0x3F, 0xF8, 0x00, 0x00, 0xFF, 0xFE, 0x00, 0x03, 0xCE, 0xEF, 0x80,
        0x07, 0x1C, 0x61, 0xC0, 0x0E, 0x18, 0x30, 0xE0, 0x18, 0x18, 0x30, 0x70,
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        0x00, 0x03, 0x01, 0x00, 0x00, 0x03, 0x00, 0x00, 0x00, 0x00, 0x00, 0x00,
    },
    { // 410
        0x00, 0x00, 0x00, 0x00, 0x00, 0x01, 0x00, 0x00, 0x00, 0x03, 0x80, 0x00,
        0x00, 0x3F, 0xF8, 0x00, 0x00, 0xFF, 0xFE, 0x00, 0x03, 0xCE, 0xEF, 0x80,
        0x07, 0x1C, 0x61, 0xC0, 0x0E, 0x18, 0x30, 0xE0, 0x18, 0x18, 0x30, 0x70,
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        0x01, 0x03, 0x1C, 0x38, 0x00, 0x03, 0x10, 0x20, 0x00, 0x00, 0x00, 0x00,
    },
    { // 456
        0x00, 0x00, 0x00, 0x00, 0x00, 0x00, 0x0C, 0x00, 0x00, 0x00, 0x1C, 0x00,
        0x00, 0x00, 0x3C, 0x00, 0x00, 0x00, 0x3C, 0x00, 0x00, 0x00, 0x6C, 0x00,
        0x00, 0x00, 0x6E, 0x00, 0x00, 0x07, 0x07, 0x00, 0x00, 0x3F, 0xE3, 0x80,
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        0x00, 0xE0, 0x7C, 0x00, 0x00, 0xE0, 0x30, 0x00, 0x00, 0x00, 0x00, 0x00,
    },
    { // 457
        0x00, 0x00, 0x00, 0x00, 0x00, 0x00, 0x0C, 0x00, 0x00, 0x00, 0x1C, 0x00,
        0x00, 0x00, 0x3C, 0x00, 0x00, 0x00, 0x3C, 0x00, 0x00, 0x00, 0x6C, 0x00,
        0x00, 0x00, 0x6E, 0x00, 0x00, 0x07, 0x07, 0x00, 0x00, 0x3F, 0xE3, 0x80,
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        0x00, 0xF8, 0x78, 0x00, 0x00, 0x60, 0x30, 0x00, 0x00, 0x00, 0x00, 0x00,
    },
    { // 499
        0x00, 0x00, 0x00, 0x00, 0x00, 0x02, 0x00, 0x00, 0x00, 0x37, 0x60, 0x00,
        0x00, 0x3F, 0xE0, 0x00, 0x00, 0x1F, 0xE0, 0x00, 0x06, 0x0F, 0xC3, 0x00,
        0x06, 0x07, 0x83, 0x80, 0x06, 0x07, 0x03, 0x00, 0x3F, 0x03, 0x07, 0xE0,
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        0x00, 0x3B, 0x70, 0x00, 0x00, 0x13, 0x00, 0x00, 0x00, 0x00, 0x00, 0x00,
    },
    { // 500
        0x00, 0x00, 0x00, 0x00, 0x00, 0x00, 0x00, 0x00, 0x00, 0x07, 0x80, 0x00,
        0x00, 0x1F, 0xF0, 0x00, 0x00, 0x78, 0x78, 0x00, 0x00, 0xE0, 0x1C, 0x00,
        0x01, 0xC0, 0x0E, 0x00, 0x0F, 0x80, 0x07, 0xE0, 0x3F, 0x80, 0x03, 0xF0,
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        0x7F, 0xFF, 0xFC, 0x00, 0x00, 0x00, 0x00, 0x00, 0x00, 0x00, 0x00, 0x00,
    },
    { // 501
        0x00, 0x00, 0x00, 0x00, 0x00, 0x07, 0x80, 0x00, 0x00, 0x1F, 0xF0, 0x00,
        0x00, 0x78, 0x78, 0x00, 0x00, 0xE0, 0x1C, 0x00, 0x01, 0xC0, 0x0E, 0x00,
        0x0F, 0x80, 0x07, 0xE0, 0x1F, 0x80, 0x03, 0xF0, 0x30, 0x00, 0x00, 0x38,
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        0x00, 0x7F, 0xFF, 0x80, 0x00, 0xFF, 0xFF, 0xC0, 0x00, 0x00, 0x00, 0x00,
    },
    { // 502
        0x00, 0x00, 0x00, 0x00, 0x00, 0x00, 0x00, 0x00, 0x00, 0x00, 0x00, 0x00,
        0x00, 0x00, 0x00, 0x00, 0x00, 0x00, 0x00, 0x00, 0x00, 0x00, 0x00, 0x00,
        0x00, 0x00, 0x00, 0x00, 0x00, 0x00, 0x00, 0x00, 0x00, 0x00, 0x00, 0x00,
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        0x00, 0x00, 0x00, 0x00, 0x00, 0x00, 0x00, 0x00, 0x00, 0x00, 0x00, 0x00,
    },
    { // 503
        0x00, 0x00, 0x00, 0x00, 0x00, 0x00, 0x00, 0x00, 0x01, 0x83, 0x06, 0x00,
        0x03, 0x87, 0x07, 0x80, 0x01, 0x83, 0x03, 0xE0, 0x00, 0x00, 0x00, 0x70,
        0x00, 0x38, 0x00, 0x38, 0x00, 0x38, 0x20, 0x18, 0x00, 0x00, 0x70, 0x18,
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        0x00, 0x00, 0x00, 0x00, 0x00, 0x00, 0x00, 0x00, 0x00, 0x00, 0x00, 0x00,
    },
    { // 504
        0x00, 0x00, 0x00, 0x00, 0x00, 0x00, 0x00, 0x00, 0x00, 0x08, 0x00, 0x00,
        0x00, 0x18, 0x0C, 0x00, 0x18, 0x00, 0x07, 0x00, 0x3C, 0x00, 0x03, 0xC0,
        0x3C, 0x01, 0xC3, 0xE0, 0x18, 0x01, 0xE3, 0x70, 0x00, 0x01, 0xE3, 0x38,
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        0x00, 0x1C, 0x78, 0x00, 0x00, 0x00, 0x00, 0x00, 0x00, 0x00, 0x00, 0x00,
    },
    { // 507
        0x00, 0x00, 0x00, 0x00, 0x00, 0x07, 0xC0, 0x00, 0x00, 0x1F, 0xF0, 0x00,
        0x00, 0x3F, 0xFC, 0x00, 0x00, 0x7F, 0xFE, 0x00, 0x00, 0xF8, 0x3E, 0x00,
        0x00, 0xF0, 0x1E, 0x00, 0x00, 0xF0, 0x00, 0x00, 0x00, 0xF0, 0x00, 0x00,
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        0x00, 0x7F, 0xF8, 0x00, 0x00, 0x1F, 0xF0, 0x00, 0x00, 0x00, 0x00, 0x00,
    },
    { // 508
        0x00, 0x00, 0x00, 0x00, 0x00, 0x07, 0xC0, 0x00, 0x00, 0x1F, 0xF0, 0x00,
        0x00, 0x3F, 0xFC, 0x00, 0x00, 0x7F, 0xFE, 0x00, 0x00, 0xF8, 0x3E, 0x00,
        0x00, 0xF0, 0x1E, 0x00, 0x00, 0xF0, 0x00, 0x00, 0x1F, 0xFF, 0xFB, 0xE0,
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        0x00, 0x7F, 0xF8, 0x00, 0x00, 0x1F, 0xF0, 0x00, 0x00, 0x00, 0x00, 0x00,
    },
    { // 509
        0x00, 0x00, 0x00, 0x00, 0x00, 0x07, 0x80, 0x00, 0x00, 0x1F, 0xF0, 0x00,
        0x00, 0x78, 0x78, 0x00, 0x00, 0xE0, 0x1C, 0x00, 0x01, 0xC0, 0x0E, 0x00,
        0x0F, 0x80, 0x07, 0xE0, 0x1F, 0x80, 0x03, 0xF0, 0x30, 0x00, 0x00, 0x38,
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        0x00, 0x00, 0x00, 0x00, 0x01, 0xFF, 0xFF, 0x00, 0x00, 0x00, 0x00, 0x00,
    },
    { // 510
        0x00, 0x00, 0x00, 0x00, 0x00, 0x07, 0x80, 0x00, 0x00, 0x1F, 0x80, 0x00,
        0x00, 0x78, 0x00, 0x00, 0x00, 0xE0, 0x00, 0x00, 0x01, 0xC0, 0x0F, 0xF8,
        0x0F, 0x80, 0x1F, 0xF8, 0x1F, 0x80, 0xFF, 0xC0, 0x30, 0x00, 0xFF, 0x80,
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        0x00, 0x00, 0x00, 0x00, 0x01, 0xFF, 0xFF, 0x00, 0x00, 0x00, 0x00, 0x00,
    },
    { // 511
        0x00, 0x00, 0x00, 0x00, 0x00, 0x00, 0x00, 0x00, 0x00, 0x00, 0x00, 0x00,
        0x03, 0x00, 0x01, 0x80, 0x07, 0x00, 0x03, 0xC0, 0x07, 0x00, 0x03, 0xC0,
        0x07, 0x00, 0x01, 0x80, 0x00, 0x00, 0x00, 0x00, 0x00, 0x00, 0x00, 0x00,
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        0x00, 0x00, 0x00, 0x00, 0x00, 0x00, 0x00, 0x00, 0x00, 0x00, 0x00, 0x00,
    },
    { // 512
        0x00, 0x00, 0x00, 0x00, 0x00, 0x00, 0x00, 0x00, 0x00, 0x00, 0x00, 0x00,
        0x03, 0x00, 0x01, 0x80, 0x07, 0x03, 0x83, 0xC0, 0x07, 0x03, 0x83, 0xC0,
        0x07, 0x03, 0x81, 0x80, 0x00, 0x03, 0x00, 0x00, 0x00, 0x00, 0x00, 0x00,
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        0x00, 0x00, 0x00, 0x00, 0x00, 0x00, 0x00, 0x00, 0x00, 0x00, 0x00, 0x00,
    },
    { // 513
        0x00, 0x00, 0x00, 0x00, 0x00, 0x00, 0x00, 0x00, 0x00, 0x00, 0x00, 0x00,
        0x0C, 0x00, 0x00, 0x60, 0x1E, 0x18, 0x30, 0xF0, 0x1E, 0x3C, 0x78, 0xF0,
        0x0C, 0x3C, 0x78, 0x60, 0x00, 0x18, 0x30, 0x00, 0x00, 0x00, 0x00, 0x00,
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        0x00, 0x00, 0x00, 0x00, 0x00, 0x00, 0x00, 0x00, 0x00, 0x00, 0x00, 0x00,
    },
    { // 514
        0x00, 0x00, 0x00, 0x00, 0x00, 0x07, 0x80, 0x00, 0x00, 0x1F, 0x80, 0x00,
        0x00, 0x78, 0x00, 0x00, 0x00, 0xE0, 0x00, 0x00, 0x01, 0xC3, 0xFF, 0x00,
        0x0F, 0x83, 0xFF, 0x00, 0x1F, 0x80, 0x00, 0x00, 0x30, 0x00, 0x1F, 0xF8,
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        0x00, 0x7F, 0xFF, 0x80, 0x00, 0xFF, 0xFF, 0xC0, 0x00, 0x00, 0x00, 0x00,
    },
    { // 515
        0x00, 0x00, 0x00, 0x00, 0x00, 0x07, 0x80, 0x00, 0x00, 0x1F, 0x80, 0x00,
        0x00, 0x78, 0x00, 0x00, 0x00, 0xE0, 0x00, 0x00, 0x01, 0xC0, 0x0F, 0xF8,
        0x0F, 0x80, 0x1F, 0xF8, 0x1F, 0x80, 0xFF, 0xC0, 0x30, 0x00, 0xFF, 0x80,
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        0x00, 0x00, 0x00, 0x00, 0x3F, 0x3F, 0x9F, 0xF8, 0x00, 0x00, 0x00, 0x00,
    },
    { // 900
        0x00, 0x00, 0x00, 0x00, 0x00, 0x00, 0x0E, 0x00, 0x00, 0x00, 0x3F, 0x80,
        0x02, 0x00, 0x3F, 0x80, 0x06, 0x00, 0x71, 0xC0, 0x0E, 0x00, 0x60, 0xC0,
        0x0E, 0x40, 0x64, 0xC0, 0x0F, 0xC0, 0x64, 0xC0, 0x2F, 0xE0, 0x6C, 0xC0,
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        0x00, 0x00, 0xFF, 0xE0, 0x00, 0x00, 0x3F, 0x80, 0x00, 0x00, 0x00, 0x00,
    },
    { // 901
        0x00, 0x00, 0x00, 0x00, 0x00, 0x00, 0x1C, 0x00, 0x00, 0x00, 0x3F, 0x00,
        0x06, 0x00, 0x7F, 0x00, 0x06, 0x00, 0xE3, 0x80, 0x36, 0xC0, 0xE1, 0x80,
        0x7F, 0xE0, 0xE1, 0x80, 0x3F, 0xC0, 0xE1, 0x80, 0x1F, 0x80, 0xE1, 0x80,
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        0x00, 0x01, 0xFF, 0xC0, 0x00, 0x00, 0x7F, 0x00, 0x00, 0x00, 0x00, 0x00,
    },
    { // 999
        0x00, 0x00, 0x00, 0x00, 0x00, 0x00, 0x00, 0x00, 0x00, 0x00, 0x00, 0x00,
        0x00, 0x00, 0x00, 0x00, 0x00, 0x00, 0x00, 0x00, 0x00, 0x00, 0x00, 0x00,
        0x00, 0x07, 0x80, 0x00, 0x00, 0x1F, 0xF0, 0x00, 0x00, 0x7C, 0x78, 0x00,
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        0x00, 0x00, 0x00, 0x00, 0x00, 0x00, 0x00, 0x00, 0x00, 0x00, 0x00, 0x00,
    },
};
