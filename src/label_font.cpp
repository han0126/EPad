#include "label_font.h"

#include <Arduino.h>

namespace {

// Compact 5 x 7 font. Bit 0 is the top row.
const uint8_t DIGIT_FONT[10][5] PROGMEM = {
    {0x3E, 0x51, 0x49, 0x45, 0x3E}, {0x00, 0x42, 0x7F, 0x40, 0x00},
    {0x42, 0x61, 0x51, 0x49, 0x46}, {0x21, 0x41, 0x45, 0x4B, 0x31},
    {0x18, 0x14, 0x12, 0x7F, 0x10}, {0x27, 0x45, 0x45, 0x45, 0x39},
    {0x3C, 0x4A, 0x49, 0x49, 0x30}, {0x01, 0x71, 0x09, 0x05, 0x03},
    {0x36, 0x49, 0x49, 0x49, 0x36}, {0x06, 0x49, 0x49, 0x29, 0x1E},
};

const uint8_t LETTER_FONT[26][5] PROGMEM = {
    {0x7E, 0x11, 0x11, 0x11, 0x7E}, {0x7F, 0x49, 0x49, 0x49, 0x36},
    {0x3E, 0x41, 0x41, 0x41, 0x22}, {0x7F, 0x41, 0x41, 0x22, 0x1C},
    {0x7F, 0x49, 0x49, 0x49, 0x41}, {0x7F, 0x09, 0x09, 0x09, 0x01},
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    {0x07, 0x08, 0x70, 0x08, 0x07}, {0x61, 0x51, 0x49, 0x45, 0x43},
};

uint8_t fontColumn(char character, uint8_t column) {
  if (character >= '0' && character <= '9') {
    return pgm_read_byte(&DIGIT_FONT[character - '0'][column]);
  }
  if (character >= 'A' && character <= 'Z') {
    return pgm_read_byte(&LETTER_FONT[character - 'A'][column]);
  }
  if (character == '.') {
    constexpr uint8_t dot[5] = {0x00, 0x60, 0x60, 0x00, 0x00};
    return dot[column];
  }
  if (character == '-') return 0x08;
  if (character == '/') {
    constexpr uint8_t slash[5] = {0x20, 0x10, 0x08, 0x04, 0x02};
    return slash[column];
  }
  return 0;
}

}  // namespace

bool textPixel(const char* text, TextLength length, uint16_t originX,
               uint16_t originY, uint8_t scale, uint16_t x, uint16_t y) {
  if (text == nullptr || length == 0 || scale == 0) return false;

  const uint16_t width = static_cast<uint16_t>(length) * 6 * scale - scale;
  const uint16_t height = 7 * scale;
  if (x < originX || x >= originX + width || y < originY ||
      y >= originY + height) {
    return false;
  }

  const uint16_t relativeX = x - originX;
  const uint8_t characterIndex = relativeX / (6 * scale);
  const uint8_t glyphX = (relativeX % (6 * scale)) / scale;
  if (glyphX >= 5) return false;

  const uint8_t glyphY = (y - originY) / scale;
  return (fontColumn(text[characterIndex], glyphX) & (1U << glyphY)) != 0;
}
